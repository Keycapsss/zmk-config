## boards/shields/dongle_screen/Kconfig.shield
```kconfig
# No whitespace after the comma or in the keyboard name!
config SHIELD_DONGLE_SCREEN
    def_bool $(shields_list_contains,dongle_screen)
```

## config/west.yml
```yaml
manifest:
  remotes:
    - name: zmkfirmware
      url-base: https://github.com/zmkfirmware
    # Forager Keyboard + Prospector
    - name: carrefinho
      url-base: https://github.com/carrefinho
    # RGB Led
    - name: caksoylar
      url-base: https://github.com/caksoylar
    # Additional modules containing boards/shields/custom code can be listed here as well
    # See https://docs.zephyrproject.org/3.2.0/develop/west/manifest.html#projects
  projects:
    - name: zmk
      remote: zmkfirmware
      revision: main
      import: app/west.yml
    - name: forager-zmk-module-dongle
      remote: carrefinho
      revision: main
    - name: prospector-zmk-module
      remote: carrefinho
      revision: main
    - name: zmk-rgbled-widget
      remote: caksoylar
      revision: main
  self:
    path: config
```
